## config/west.yml
```yaml
manifest:
  remotes:
    - name: tklzg
      url-base: https://github.com/tklzg
  projects:
    - name: zmk
      remote: tklzg
      revision: master
      import: app/west.yml
  self:
    path: config
```
